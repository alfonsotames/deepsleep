## CMakeLists.txt
```
# SPDX-License-Identifier: Apache-2.0

cmake_minimum_required(VERSION 3.13.1)
find_package(Zephyr REQUIRED HINTS $ENV{ZEPHYR_BASE})
project(deepsleep)

target_sources(app PRIVATE src/main.c)
```

## sample.yaml
```
sample:
  name: Deep Sleep
tests:
  deepsleep:
    tags: LED gpio
    filter: dt_compat_enabled_with_alias("gpio-leds", "led0")
    depends_on: gpio
    harness: led
    integration_platforms:
      - frdm_k64f
```

## prj.conf
```kconfig
CONFIG_GPIO=y
CONFIG_CONSOLE=y
CONFIG_SERIAL=y
CONFIG_LOG=y
CONFIG_LOG_DEFAULT_LEVEL=4
```

## src/main.c
```c
#include <zephyr.h>
#include <device.h>
#include <drivers/gpio.h>
#include <drivers/timer/system_timer.h>
#include <sys/util.h>
#include <sys///printk.h>
#include <inttypes.h>
#include <soc.h>

#define SLEEP_TIME_MS   80

// Switch Button and Led configured in dts at:
// LED0 = Pin PA17
// SW0 = Pin PA21

#define LED0_NODE       DT_ALIAS(led0)
#define LED0_GPIO_LABEL DT_GPIO_LABEL(LED0_NODE, gpios)
#define LED0_GPIO_PIN   DT_GPIO_PIN(LED0_NODE, gpios)
#define LED0_GPIO_FLAGS (GPIO_OUTPUT | DT_GPIO_FLAGS(LED0_NODE, gpios))

#define SW0_NODE        DT_ALIAS(sw0)
#define SW0_GPIO_LABEL  DT_GPIO_LABEL(SW0_NODE, gpios)
#define SW0_GPIO_PIN    DT_GPIO_PIN(SW0_NODE, gpios)
#define SW0_GPIO_FLAGS  (GPIO_INPUT | DT_GPIO_FLAGS(SW0_NODE, gpios))

// Enable EIC clock with the Ultra Low Power 32Khz clock OSCULP32K
// for interrupt working on GPIO_INT_EDGE_RISING

void config_eic_clk() {
    //GCLK->CLKCTRL.bit.CLKEN = 0; //disable GCLK module
    while (GCLK->STATUS.bit.SYNCBUSY);
    GCLK->CLKCTRL.reg = (uint16_t) (GCLK_CLKCTRL_CLKEN | GCLK_CLKCTRL_GEN_GCLK6
            | GCLK_CLKCTRL_ID(0x05U)); //EIC clock switched on GCLK1
    while (GCLK->STATUS.bit.SYNCBUSY);
    GCLK->GENCTRL.reg = (GCLK_GENCTRL_GENEN | GCLK_GENCTRL_SRC_OSCULP32K
            | GCLK_GENCTRL_ID(6)); //source for GCLK6 is OSCULP32K
    while (GCLK->STATUS.reg & GCLK_STATUS_SYNCBUSY);
    GCLK->GENCTRL.bit.RUNSTDBY = 1; //GCLK1 run standby
    while (GCLK->STATUS.reg & GCLK_STATUS_SYNCBUSY);
}

static struct gpio_callback button_cb_data;

volatile bool pressed; 
void button_pressed(const struct device *dev, struct gpio_callback *cb, uint32_t pins) {
    printk("Button pressed\n");
    pressed=true;
}

void sleep() {
    NVMCTRL->CTRLB.bit.SLEEPPRM = NVMCTRL_CTRLB_SLEEPPRM_DISABLED_Val;
    SysTick->CTRL &= ~SysTick_CTRL_TICKINT_Msk;
    printk("GOING TO SLEEP...");
    SCB->SCR |= SCB_SCR_SLEEPDEEP_Msk;
    while (WDT->STATUS.bit.SYNCBUSY);
    __DSB(); // Data sync to ensure outgoing memory accesses complete
    __WFI(); // Wait for interrupt (places device in sleep mode) 
    while (WDT->STATUS.bit.SYNCBUSY);
    SysTick->CTRL |= SysTick_CTRL_TICKINT_Msk;
    printk("AWAKE!");
}

const struct device *button;
const struct device *led;

// Blink LED0 5 times
void blink() {
    bool led_is_on = false;
    for (int x=0; x<10; x++) {
        gpio_pin_set(led, LED0_GPIO_PIN, (int) led_is_on);
        led_is_on = !led_is_on;
        k_msleep(SLEEP_TIME_MS);
        
    }
}

void main() {

    config_eic_clk();

    pressed=false;
    int ret;

    button = device_get_binding(SW0_GPIO_LABEL);
    led = device_get_binding(LED0_GPIO_LABEL);

    if (button == NULL) {
        printk("Error: didn't find %s device\n", SW0_GPIO_LABEL);
        return;
    }
    if (led == NULL) {
        printk("Error: didn't find %s device\n", LED0_GPIO_LABEL);
        return;
    }

    ret = gpio_pin_configure(led, LED0_GPIO_PIN, LED0_GPIO_FLAGS);
    if (ret != 0) {
        printk("Error %d: failed to configure LED device %s pin %d\n", ret, 
                LED0_GPIO_LABEL, LED0_GPIO_PIN);
        return;
    }

    ret = gpio_pin_configure(button, SW0_GPIO_PIN, SW0_GPIO_FLAGS);
    if (ret != 0) {
        printk("Error %d: failed to configure %s pin %d\n", ret, 
                SW0_GPIO_LABEL, SW0_GPIO_PIN);
        return;
    } 

    ret = gpio_pin_interrupt_configure(button, SW0_GPIO_PIN,
            GPIO_INT_EDGE_RISING | GPIO_INT_DEBOUNCE);
    if (ret != 0) {
        printk("Error %d: failed to configure interrupt on %s pin %d\n", ret, 
                SW0_GPIO_LABEL, SW0_GPIO_PIN);
        return;
    }

    gpio_init_callback(&button_cb_data, button_pressed, BIT(SW0_GPIO_PIN));
    gpio_add_callback(button, &button_cb_data);

    EIC->WAKEUP.reg |= (1 << 5U); // Configured in EXTINT5 for PA21

    while (1) {
        if (pressed) {
            blink();
            pressed=false;
            sleep(); // Go to deep sleep
        }
        k_msleep(1);
    }

}
```

## src/buttons.c
```c
/*
 * To change this license header, choose License Headers in Project Properties.
 * To change this template file, choose Tools | Templates
 * and open the template in the editor.
 */

/* 
 * File:   buttons.c
 * Author: mufufu
 *
 * Created on November 6, 2020, 2:12 PM
 */

#include "buttons.h"

/*
 * 
 */


 const struct device *button0;
 const struct device *button1;
 const struct device *button2;
 const struct device *button3;
 const struct device *led;
 const struct device *backlight;
 const struct device *buz;

 struct gpio_callback button0_cb_data;
 struct gpio_callback button1_cb_data;
 struct gpio_callback button2_cb_data;
 struct gpio_callback button3_cb_data;


void init_buttons() {

    
    led = device_get_binding(LED0_GPIO_LABEL);
    backlight = device_get_binding(BACKLIGHT0_GPIO_LABEL);
    buz = device_get_binding(BUZ0_GPIO_LABEL);    
    button0 = device_get_binding(SW0_GPIO_LABEL);
    button1 = device_get_binding(SW1_GPIO_LABEL);
    button2 = device_get_binding(SW2_GPIO_LABEL);
    button3 = device_get_binding(SW3_GPIO_LABEL);
    
    


    int ret;
    

    if (button0 == NULL) {
        printk("Error: didn't find %s device\n", SW0_GPIO_LABEL);
        return;
    }
    if (button1 == NULL) {
        printk("Error: didn't find %s device\n", SW1_GPIO_LABEL);
        return;
    }
    if (button2 == NULL) {
        printk("Error: didn't find %s device\n", SW2_GPIO_LABEL);
        return;
    }
    if (button3 == NULL) {
        printk("Error: didn't find %s device\n", SW3_GPIO_LABEL);
        return;
    }    
    if (led == NULL) {
        printk("Error: didn't find %s device\n", LED0_GPIO_LABEL);
        return;
    }
    if (backlight == NULL) {
        printk("Error: didn't find %s device\n", BACKLIGHT0_GPIO_LABEL);
        return;
    }
    if (buz == NULL) {
        printk("Error: didn't find %s device\n", BUZ0_GPIO_LABEL);
        return;
    }
    

    /************ Led 0 ***********/
    ret = gpio_pin_configure(led, LED0_GPIO_PIN, LED0_GPIO_FLAGS);
    if (ret != 0) {
        printk("Error %d: failed to configure LED device %s pin %d\n", ret, 
                LED0_GPIO_LABEL, LED0_GPIO_PIN);
        return;
    }

    /************ Backlight ***********/
    ret = gpio_pin_configure(led, BACKLIGHT0_GPIO_PIN, BACKLIGHT0_GPIO_FLAGS);
    if (ret != 0) {
        printk("Error %d: failed to configure LED device %s pin %d\n", ret, 
                BACKLIGHT0_GPIO_LABEL, BACKLIGHT0_GPIO_PIN);
        return;
    }
    
     /************ Buzzer ***********/
    ret = gpio_pin_configure(buz, BUZ0_GPIO_PIN, BUZ0_GPIO_FLAGS);
    if (ret != 0) {
        printk("Error %d: failed to configure BUZZER device %s pin %d\n", ret, 
                BUZ0_GPIO_LABEL, BUZ0_GPIO_PIN);
        return;
    }  
    
    /************ Button 0 ***********/
    ret = gpio_pin_configure(button0, SW0_GPIO_PIN, SW0_GPIO_FLAGS);
    if (ret != 0) {
        printk("Error %d: failed to configure %s pin %d\n", ret, 
                SW0_GPIO_LABEL, SW0_GPIO_PIN);
        return;
    } 

    ret = gpio_pin_interrupt_configure(button0, SW0_GPIO_PIN,
            GPIO_INT_EDGE_RISING | GPIO_INT_DEBOUNCE);
    if (ret != 0) {
        printk("Error %d: failed to configure interrupt on %s pin %d\n", ret, 
                SW0_GPIO_LABEL, SW0_GPIO_PIN);
        return;
    }
    gpio_init_callback(&button0_cb_data, button0_pressed, BIT(SW0_GPIO_PIN));
    gpio_add_callback(button0, &button0_cb_data);
    
    /************ Button 1 ***********/
    
    ret = gpio_pin_configure(button1, SW1_GPIO_PIN, SW1_GPIO_FLAGS);
    if (ret != 0) {
        printk("Error %d: failed to configure %s pin %d\n", ret, 
                SW1_GPIO_LABEL, SW1_GPIO_PIN);
        return;
    } 

    ret = gpio_pin_interrupt_configure(button1, SW1_GPIO_PIN,
            GPIO_INT_EDGE_RISING | GPIO_INT_DEBOUNCE);
    if (ret != 0) {
        printk("Error %d: failed to configure interrupt on %s pin %d\n", ret, 
                SW1_GPIO_LABEL, SW1_GPIO_PIN);
        return;
    }
    gpio_init_callback(&button1_cb_data, button1_pressed, BIT(SW1_GPIO_PIN));
    gpio_add_callback(button1, &button1_cb_data);
    
    /************ Button 2 ***********/
    ret = gpio_pin_configure(button2, SW2_GPIO_PIN, SW2_GPIO_FLAGS);
    if (ret != 0) {
        printk("Error %d: failed to configure %s pin %d\n", ret, 
                SW2_GPIO_LABEL, SW2_GPIO_PIN);
        return;
    } 

    ret = gpio_pin_interrupt_configure(button2, SW2_GPIO_PIN,
            GPIO_INT_EDGE_RISING | GPIO_INT_DEBOUNCE);
    if (ret != 0) {
        printk("Error %d: failed to configure interrupt on %s pin %d\n", ret, 
                SW2_GPIO_LABEL, SW2_GPIO_PIN);
        return;
    }
    gpio_init_callback(&button2_cb_data, button2_pressed, BIT(SW2_GPIO_PIN));
    gpio_add_callback(button2, &button2_cb_data);
    
    /************ Button 3 ***********/
    ret = gpio_pin_configure(button3, SW3_GPIO_PIN, SW3_GPIO_FLAGS);
    if (ret != 0) {
        printk("Error %d: failed to configure %s pin %d\n", ret, 
                SW3_GPIO_LABEL, SW3_GPIO_PIN);
        return;
    } 

    ret = gpio_pin_interrupt_configure(button3, SW3_GPIO_PIN,
            GPIO_INT_EDGE_RISING | GPIO_INT_DEBOUNCE);
    if (ret != 0) {
        printk("Error %d: failed to configure interrupt on %s pin %d\n", ret, 
                SW3_GPIO_LABEL, SW3_GPIO_PIN);
        return;
    }
    gpio_init_callback(&button3_cb_data, button3_pressed, BIT(SW3_GPIO_PIN));
    gpio_add_callback(button3, &button3_cb_data);
    
    
}
```

## src/buttons.h
```c
/*
 * To change this license header, choose License Headers in Project Properties.
 * To change this template file, choose Tools | Templates
 * and open the template in the editor.
 */

/* 
 * File:   buttons.h
 * Author: mufufu
 *
 * Created on November 6, 2020, 2:09 PM
 */

#ifndef BUTTONS_H
#define BUTTONS_H

#ifdef __cplusplus
extern "C" {
#endif
    
    
#include <device.h>
#include <drivers/gpio.h>
    
    
#define LED0_NODE       DT_ALIAS(led0)
#define LED0_GPIO_LABEL DT_GPIO_LABEL(LED0_NODE, gpios)
#define LED0_GPIO_PIN   DT_GPIO_PIN(LED0_NODE, gpios)
#define LED0_GPIO_FLAGS (GPIO_OUTPUT | DT_GPIO_FLAGS(LED0_NODE, gpios))
    
#define BACKLIGHT0_NODE       DT_ALIAS(backlight0)
#define BACKLIGHT0_GPIO_LABEL DT_GPIO_LABEL(BACKLIGHT0_NODE, gpios)
#define BACKLIGHT0_GPIO_PIN   DT_GPIO_PIN(BACKLIGHT0_NODE, gpios)
#define BACKLIGHT0_GPIO_FLAGS (GPIO_OUTPUT | DT_GPIO_FLAGS(BACKLIGHT0_NODE, gpios))    

#define BUZ0_NODE       DT_ALIAS(buz0)
#define BUZ0_GPIO_LABEL DT_GPIO_LABEL(BUZ0_NODE, gpios)
#define BUZ0_GPIO_PIN   DT_GPIO_PIN(BUZ0_NODE, gpios)
#define BUZ0_GPIO_FLAGS (GPIO_OUTPUT | DT_GPIO_FLAGS(BUZ0_NODE, gpios))

#define SW0_NODE        DT_ALIAS(sw0)
#define SW0_GPIO_LABEL  DT_GPIO_LABEL(SW0_NODE, gpios)
#define SW0_GPIO_PIN    DT_GPIO_PIN(SW0_NODE, gpios)
#define SW0_GPIO_FLAGS  (GPIO_INPUT | DT_GPIO_FLAGS(SW0_NODE, gpios))

#define SW1_NODE        DT_ALIAS(sw1)
#define SW1_GPIO_LABEL  DT_GPIO_LABEL(SW1_NODE, gpios)
#define SW1_GPIO_PIN    DT_GPIO_PIN(SW1_NODE, gpios)
#define SW1_GPIO_FLAGS  (GPIO_INPUT | DT_GPIO_FLAGS(SW1_NODE, gpios))

#define SW2_NODE        DT_ALIAS(sw2)
#define SW2_GPIO_LABEL  DT_GPIO_LABEL(SW2_NODE, gpios)
#define SW2_GPIO_PIN    DT_GPIO_PIN(SW2_NODE, gpios)
#define SW2_GPIO_FLAGS  (GPIO_INPUT | DT_GPIO_FLAGS(SW2_NODE, gpios))

#define SW3_NODE        DT_ALIAS(sw3)
#define SW3_GPIO_LABEL  DT_GPIO_LABEL(SW3_NODE, gpios)
#define SW3_GPIO_PIN    DT_GPIO_PIN(SW3_NODE, gpios)
#define SW3_GPIO_FLAGS  (GPIO_INPUT | DT_GPIO_FLAGS(SW3_NODE, gpios))
    
    
extern const struct device *button0;
extern const struct device *button1;
extern const struct device *button2;
extern const struct device *button3;
extern const struct device *led;
extern const struct device *backlight;
extern const struct device *buz;

extern struct gpio_callback button0_cb_data;
extern struct gpio_callback button1_cb_data;
extern struct gpio_callback button2_cb_data;
extern struct gpio_callback button3_cb_data;

void button0_pressed(const struct device *dev, struct gpio_callback *cb, uint32_t pins);
void button1_pressed(const struct device *dev, struct gpio_callback *cb, uint32_t pins);
void button2_pressed(const struct device *dev, struct gpio_callback *cb, uint32_t pins);
void button3_pressed(const struct device *dev, struct gpio_callback *cb, uint32_t pins);


void init_buttons();


#ifdef __cplusplus
}
#endif

#endif /* BUTTONS_H */
```
